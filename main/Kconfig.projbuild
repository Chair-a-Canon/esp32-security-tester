## main/Kconfig.projbuild
```kconfig
config TOOL_AP_SSID
    string "Setup SoftAP SSID"
    default "ESP32-Injector-Setup"
    help
        SSID for the device's own open setup access point. Connect to
        this network first to reach the web UI, then use its Wi-Fi
        scan/connect panel to join your actual target network. No
        target-network credentials are ever baked into firmware - this
        is the only Wi-Fi identifier configured at build time, and it
        has no password.
```
